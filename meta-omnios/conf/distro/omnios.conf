## meta-omnios/conf/distro/omnios.conf
```bitbake
require conf/distro/poky.conf

DISTRO = "omnios"
DISTRO_NAME = "OmniOS"
DISTRO_VERSION = "1.0"
DISTRO_CODENAME = "origin"
OMNIOS_RELEASE_REVISION ?= "0"
OMNIOS_BUNDLE_VERSION = "${DISTRO_VERSION}.${OMNIOS_RELEASE_REVISION}"
MAINTAINER = "OmniNodeCo <https://github.com/OmniNodeCo/OmniOS>"

TARGET_VENDOR = "-omnios"
SDK_VENDOR = "-omnios"
SDK_VERSION = "${DISTRO_VERSION}"

INIT_MANAGER = "systemd"
VIRTUAL-RUNTIME_init_manager = "systemd"
VIRTUAL-RUNTIME_initscripts = ""

PACKAGE_CLASSES = "package_rpm"
EXTRA_IMAGE_FEATURES:append = " package-management"
# FFmpeg is free software, but OE marks it commercial because patent
# obligations vary by country and distributor.
LICENSE_FLAGS_ACCEPTED += "commercial"

DISTRO_FEATURES:append = " systemd usrmerge wayland x11 opengl vulkan pam polkit desktop-portal wifi bluetooth ipv6 zeroconf pni-names rauc"
DISTRO_FEATURES:remove = "sysvinit directfb"
DISTRO_FEATURES_OPTED_OUT += "sysvinit"

PREFERRED_PROVIDER_udev = "systemd"
PREFERRED_PROVIDER_udev-utils = "systemd"
PREFERRED_PROVIDER_virtual/kernel = "linux-yocto"
PREFERRED_VERSION_linux-yocto = "6.18%"
PREFERRED_RPROVIDER_virtual-grub-bootconf = "omnios-grubconf"
PREFERRED_RPROVIDER_virtual-rauc-conf = "omnios-rauc-conf"

INHERIT += "buildhistory"
BUILDHISTORY_COMMIT = "0"
```

## meta-omnios/conf/layer.conf
```bitbake
BBPATH .= ":${LAYERDIR}"
BBFILES += "${LAYERDIR}/recipes-*/*/*.bb ${LAYERDIR}/recipes-*/*/*.bbappend"
BBFILE_COLLECTIONS += "omnios"
BBFILE_PATTERN_omnios = "^${LAYERDIR}/"
BBFILE_PRIORITY_omnios = "10"
LAYERDEPENDS_omnios = "core openembedded-layer networking-layer multimedia-layer meta-python filesystems-layer perl-layer qt6-layer kf6 kde rauc"
LAYERSERIES_COMPAT_omnios = "wrynose"
```
